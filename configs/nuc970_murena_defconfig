## configs/nuc970_murena_defconfig
```kconfig
CONFIG_ARM=y
CONFIG_TARGET_NUC970=y
CONFIG_CONSOLE_MUX=y
CONFIG_SYS_CONSOLE_OVERWRITE_ROUTINE=y
CONFIG_SYS_NO_FLASH=y
CONFIG_HUSH_PARSER=y
# CONFIG_CMD_IMLS is not set
CONFIG_CMD_MEMINFO=y
# CONFIG_CMD_FLASH is not set
CONFIG_CMD_SF=y
CONFIG_CMD_SPI=y
CONFIG_CMD_USB=y
# CONFIG_CMD_SETEXPR is not set
CONFIG_CMD_DHCP=y
CONFIG_CMD_PING=y
CONFIG_CMD_TIMER=y
CONFIG_CMD_FAT=y
CONFIG_NUC970_GPIO=y
CONFIG_NAND_NUC970=y
CONFIG_SPI_FLASH=y
CONFIG_SPI_FLASH_BAR=y
CONFIG_SPI_FLASH_MACRONIX=y
CONFIG_SPI_FLASH_WINBOND=y
CONFIG_MTD_UBI=y
CONFIG_NETDEVICES=y
CONFIG_NUC970_ETH=y
CONFIG_NUC970_EMAC0=y
CONFIG_NUC970_PHY_ADDR=1
CONFIG_NUC970_CONSOLE=y
CONFIG_NUC970_SPI=y
CONFIG_USB=y
CONFIG_USB_EHCI_HCD=y
CONFIG_USB_EHCI_NUC970=y
CONFIG_USB_STORAGE=y
CONFIG_NUC970_WATCHDOG=y
```
